## conf/machine/nanopi-neo2.conf
```bitbake
#@TYPE: Machine
#@NAME: nanopi-neo2
#@DESCRIPTION: Machine configuration for the FriendlyARM NanoPi Neo 2, based
# on the Allwinner H5 CPU.
 
require conf/machine/include/sun50i.inc
 
PREFERRED_VERSION_u-boot = "2018.01%"
 
KERNEL_DEVICETREE = "allwinner/sun50i-h5-nanopi-neo2.dtb"
UBOOT_MACHINE = "nanopi_neo2_defconfig"
```

## conf/machine/orange-pi-pc2.conf
```bitbake
#@TYPE: Machine
#@NAME: orange-pi-pc2
#@DESCRIPTION: Machine configuration for the orange-pi-pc2, base on allwinner H5 CPU

require conf/machine/include/sun50i.inc

PREFERRED_VERSION_linux = "4.13+git%"
PREFERRED_VERSION_u-boot = "v2017.09%"

KERNEL_DEVICETREE = "${MANUFACTURER}/sun50i-h5-orangepi-pc2.dtb"
UBOOT_MACHINE = "orangepi_pc2_defconfig"

DEFAULTTUNE = "aarch64"
```
